## drivers/input/sensors/Kconfig
```kconfig
#
# Sensor driver configuration
#
config HALL_SENSOR
       bool "Hall sensor"
       default n
```

## drivers/simcddrv/Kconfig
```kconfig
#
# SIM plug detection
#
menuconfig SIMCDDRV
	tristate "SIM plug detection"
	help
	 Say Y here
```
